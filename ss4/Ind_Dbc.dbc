VERSION ""

NS_ :

BS_:

BU_: IPC BCM

BO_ 257 GWMMessage: 1 Vector__XXX
 SG_ GWM_Signal : 0|8@1+ (1,0) [0|3] "" Vector__XXX

BO_ 256 BCMMessage: 1 BCM
 SG_ BCM_Signal : 0|8@1+ (1,0) [0|255] "" Vector__XXX
